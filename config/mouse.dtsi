/*
 * urob-style mouse tuning and aliases.
 *
 * NOTE: This expects ZMK pointing devices (mmv/msc) to be available.
 */

#define ZMK_POINTING_DEFAULT_MOVE_VAL 1500
#define ZMK_POINTING_DEFAULT_SCRL_VAL 30

#include <dt-bindings/zmk/keys.h>
#include <dt-bindings/zmk/mouse.h>
#include <dt-bindings/zmk/pointing.h>

&mmv {
  acceleration-exponent = <1>;
  time-to-max-speed-ms = <250>;
  delay-ms = <0>;
};

&msc {
  acceleration-exponent = <0>;
  time-to-max-speed-ms = <200>;
  delay-ms = <0>;
};

#define U_MS_U &mmv MOVE_UP
#define U_MS_D &mmv MOVE_DOWN
#define U_MS_L &mmv MOVE_LEFT
#define U_MS_R &mmv MOVE_RIGHT
#define U_WH_U &msc SCRL_UP
#define U_WH_D &msc SCRL_DOWN
#define U_WH_L &msc SCRL_LEFT
#define U_WH_R &msc SCRL_RIGHT


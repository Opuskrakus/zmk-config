// skeletyl_right.overlay

#include "skeletyl.dtsi"

&default_transform { // The matrix transform for this board is 5
    col-offset = <5>;
};

&kscan0 {
    col-gpios
        = <&pro_micro 4 (GPIO_ACTIVE_HIGH)> // col0 (Index - Y)
        , <&pro_micro 5 (GPIO_ACTIVE_HIGH)> // col1 (Index/Middle - U)
        , <&pro_micro 6 (GPIO_ACTIVE_HIGH)> // col2 (Middle - I)
        , <&pro_micro 7 (GPIO_ACTIVE_HIGH)> // col3 (Ring - O)
        , <&pro_micro 8 (GPIO_ACTIVE_HIGH)> // col4 (Pinky - P)
        ;
};

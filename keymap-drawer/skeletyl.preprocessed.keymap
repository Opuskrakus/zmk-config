#include <behaviors.dtsi>
#include <dt-bindings/zmk/bt.h>
#include <dt-bindings/zmk/keys.h>
#include <dt-bindings/zmk/outputs.h>

/* Key position labels (LT0..LH2/RH2 etc) */
#include <zmk-helpers/key-labels/36.h>

/* Swedish symbol macros (SV_*) */
/* --- skipped: keys_sv.h (handled by SV_MAP) --- */
/* urob modules */
#include <behaviors/unicode.dtsi>
#include <behaviors/num_word.dtsi>

/* Local split-out config */
/* --- inlined: mouse.dtsi --- */
/*
 * urob-style mouse tuning and aliases.
 *
 * NOTE: This expects ZMK pointing devices (mmv/msc) to be available.
 */

#define ZMK_POINTING_DEFAULT_MOVE_VAL 1500
#define ZMK_POINTING_DEFAULT_SCRL_VAL 30

#include <dt-bindings/zmk/keys.h>
#include <dt-bindings/zmk/mouse.h>
#include <dt-bindings/zmk/pointing.h>

&mmv {
  acceleration-exponent = <1>;
  time-to-max-speed-ms = <250>;
  delay-ms = <0>;
};

&msc {
  acceleration-exponent = <0>;
  time-to-max-speed-ms = <200>;
  delay-ms = <0>;
};

#define U_MS_U &mmv MOVE_UP
#define U_MS_D &mmv MOVE_DOWN
#define U_MS_L &mmv MOVE_LEFT
#define U_MS_R &mmv MOVE_RIGHT
#define U_WH_U &msc SCRL_UP
#define U_WH_D &msc SCRL_DOWN
#define U_WH_L &msc SCRL_LEFT
#define U_WH_R &msc SCRL_RIGHT


/* --- inlined: leader.dtsi --- */
/*
 * urob-style leader sequences (ported as-is)
 *
 * NOTE: This requires the zmk-leader-key and zmk-unicode modules (added via west.yml).
 */

#undef ZMK_LEADER_SEQUENCE
#define ZMK_LEADER_SEQUENCE(name, leader_bindings, leader_sequence) \
 / { \
  behaviors { \
   leader: leader { \
    compatible = "zmk,behavior-leader-key"; \
    #binding-cells = <0>; \
    ignore-keys = <LSHFT RSHFT LALT RALT LCTRL RCTRL LGUI RGUI>; \
    leader_sequence_##name { \
     bindings = <leader_bindings>; \
     sequence = <leader_sequence>; \
    }; \
   }; \
  }; \
 };

/* Swedish vowels (native keycodes) */
ZMK_LEADER_SEQUENCE(sv_ae, &kp ä, A) /* ä/Ä */
ZMK_LEADER_SEQUENCE(sv_oe, &kp ö, O) /* ö/Ö */
ZMK_LEADER_SEQUENCE(sv_aa, &kp å, P)   /* å/Å */

/* Greek letters */
ZMK_LEADER_SEQUENCE(el_alpha, &uc UC_EL_ALPHA, E A) /* α */
ZMK_LEADER_SEQUENCE(el_beta, &uc UC_EL_BETA, E B) /* β */
ZMK_LEADER_SEQUENCE(el_gamma, &uc UC_EL_GAMMA, E G) /* γ */
ZMK_LEADER_SEQUENCE(el_delta, &uc UC_EL_DELTA, E D) /* δ */
ZMK_LEADER_SEQUENCE(el_epsilon, &uc UC_EL_EPSILON, E E) /* ε */
ZMK_LEADER_SEQUENCE(el_zeta, &uc UC_EL_ZETA, E Z) /* ζ */
ZMK_LEADER_SEQUENCE(el_eta, &uc UC_EL_ETA, E H) /* η */
ZMK_LEADER_SEQUENCE(el_theta, &uc UC_EL_THETA, E V) /* θ */
ZMK_LEADER_SEQUENCE(el_iota, &uc UC_EL_IOTA, E I) /* ι */
ZMK_LEADER_SEQUENCE(el_kappa, &uc UC_EL_KAPPA, E K) /* κ */
ZMK_LEADER_SEQUENCE(el_lambda, &uc UC_EL_LAMBDA, E L) /* λ */
ZMK_LEADER_SEQUENCE(el_mu, &uc UC_EL_MU, E M) /* μ */
ZMK_LEADER_SEQUENCE(el_nu, &uc UC_EL_NU, E N) /* ν */
ZMK_LEADER_SEQUENCE(el_xi, &uc UC_EL_XI, E X) /* ξ */
ZMK_LEADER_SEQUENCE(el_omikron, &uc UC_EL_OMIKRON, E O) /* ο */
ZMK_LEADER_SEQUENCE(el_pi, &uc UC_EL_PI, E P) /* π */
ZMK_LEADER_SEQUENCE(el_rho, &uc UC_EL_RHO, E R) /* ρ */
ZMK_LEADER_SEQUENCE(el_sigma, &uc UC_EL_SIGMA, E S) /* σ */
ZMK_LEADER_SEQUENCE(el_tau, &uc UC_EL_TAU, E T) /* τ */
ZMK_LEADER_SEQUENCE(el_upsilon, &uc UC_EL_UPSILON, E U) /* υ */
ZMK_LEADER_SEQUENCE(el_phi, &uc UC_EL_PHI, E F) /* ϕ */
ZMK_LEADER_SEQUENCE(el_chi, &uc UC_EL_CHI, E C) /* χ */
ZMK_LEADER_SEQUENCE(el_psi, &uc UC_EL_PSI, E Y) /* ψ */
ZMK_LEADER_SEQUENCE(el_omega, &uc UC_EL_OMEGA, E W) /* ω */

/* BLE and USB */
#ifdef CONFIG_WIRELESS
ZMK_LEADER_SEQUENCE(usb, &out OUT_USB, U S B)
ZMK_LEADER_SEQUENCE(ble, &out OUT_BLE, B L E)
#endif // CONFIG_WIRELESS
ZMK_LEADER_SEQUENCE(reset, &sys_reset, R E S E T)
ZMK_LEADER_SEQUENCE(boot, &bootloader, B O O T)


#define DEF 0
#define NAV 1
#define FN  2
#define NUM 3
#define SYS 4
#define MOUSE 5

#define ___ &trans
#define XXX &none

/* Homerow mod position groups (used for hold-trigger-key-positions) */
#define KEYS_L LT0 LT1 LT2 LT3 LT4 LM0 LM1 LM2 LM3 LM4 LB0 LB1 LB2 LB3 LB4
#define KEYS_R RT0 RT1 RT2 RT3 RT4 RM0 RM1 RM2 RM3 RM4 RB0 RB1 RB2 RB3 RB4
#define THUMBS LH2 LH1 LH0 RH0 RH1 RH2

/* Global tweaks (urob-style) */
&sk {
  release-after-ms = <900>;
  quick-release;
};

&sl {
  ignore-modifiers;
};

&lt {
  flavor = "balanced";
  tapping-term-ms = <200>;
  quick-tap-ms = <175>;
};

/* Unicode defaults: macOS is the most likely given your host machine */
&uc {
  default-mode = <UC_MODE_MACOS>;
};

/ {
  behaviors {
    /* Timeless HRMs (balanced + positional hold-tap, trigger on release) */
    hml: hml {
      compatible = "zmk,behavior-hold-tap";
      label = "HML";
      #binding-cells = <2>;
      flavor = "balanced";
      tapping-term-ms = <280>;
      quick-tap-ms = <175>;
      require-prior-idle-ms = <150>;
      bindings = <&kp>, <&kp>;
      hold-trigger-key-positions = <KEYS_R THUMBS>;
      hold-trigger-on-release;
    };

    hmr: hmr {
      compatible = "zmk,behavior-hold-tap";
      label = "HMR";
      #binding-cells = <2>;
      flavor = "balanced";
      tapping-term-ms = <280>;
      quick-tap-ms = <175>;
      require-prior-idle-ms = <150>;
      bindings = <&kp>, <&kp>;
      hold-trigger-key-positions = <KEYS_L THUMBS>;
      hold-trigger-on-release;
    };

    /* Tri-state swapper (Alt-Tab) */
    swapper: swapper {
      compatible = "zmk,behavior-tri-state";
      label = "SWAPPER";
      #binding-cells = <0>;
      bindings = <&kt LALT>, <&kp TAB>, <&kt LALT>;
      ignored-layers = <NAV>;
    };

    /* Smart mouse toggle (tri-state): turns off on left-hand key press */
    smart_mouse: smart_mouse {
      compatible = "zmk,behavior-tri-state";
      label = "SMART_MOUSE";
      #binding-cells = <0>;
      bindings = <&tog MOUSE>, <&none>, <&tog MOUSE>;
      ignored-key-positions = <3 2 KEYS_R THUMBS>;
      ignored-layers = <MOUSE>;
    };

    /* Shift-repeat (adaptive key): repeat after any alpha */
    shift_repeat: shift_repeat {
      compatible = "zmk,behavior-adaptive-key";
      label = "SHIFT_REPEAT";
      #binding-cells = <0>;
      bindings = <&sk LSHFT>;

      repeat {
        trigger-keys = <A B C D E F G H I J K L M N O P Q R S T U V W X Y Z>;
        bindings = <&key_repeat>;
        max-prior-idle-ms = <1200>;
        strict-modifiers;
      };
    };

    /* Magic shift: tap = repeat/sticky-shift, shifted tap = caps-word, hold = shift */
    magic_shift_tap: magic_shift_tap {
      compatible = "zmk,behavior-mod-morph";
      label = "MAGIC_SHIFT_TAP";
      #binding-cells = <0>;
      bindings = <&shift_repeat>, <&caps_word>;
      mods = <(MOD_LSFT)>;
    };

    magic_shift: magic_shift {
      compatible = "zmk,behavior-hold-tap";
      label = "MAGIC_SHIFT";
      #binding-cells = <2>;
      flavor = "balanced";
      tapping-term-ms = <200>;
      quick-tap-ms = <175>;
      bindings = <&kp>, <&magic_shift_tap>;
    };

    /* Smart num: tap = num-word, double-tap = sticky NUM, hold = momentary NUM */
    num_dance: num_dance {
      compatible = "zmk,behavior-tap-dance";
      label = "NUM_DANCE";
      #binding-cells = <0>;
      tapping-term-ms = <200>;
      bindings = <&num_word NUM>, <&sl NUM>;
    };

    smart_num: smart_num {
      compatible = "zmk,behavior-hold-tap";
      label = "SMART_NUM";
      #binding-cells = <2>;
      flavor = "balanced";
      tapping-term-ms = <200>;
      quick-tap-ms = <175>;
      bindings = <&mo>, <&num_dance>;
    };

    /* Tap: bspc | Shift+tap: del */
    bs_del: bs_del {
      compatible = "zmk,behavior-mod-morph";
      label = "BS_DEL";
      #binding-cells = <0>;
      bindings = <&kp BSPC>, <&kp DEL>;
      mods = <(MOD_LSFT|MOD_RSFT)>;
    };

    /* Paren combos: tap = () | Shift+tap = <> */
    lpar_lt: lpar_lt {
      compatible = "zmk,behavior-mod-morph";
      label = "LPAR_LT";
      #binding-cells = <0>;
      bindings = <&kp (>, <&kp DT_LT>;
      mods = <(MOD_LSFT|MOD_RSFT)>;
    };

    rpar_gt: rpar_gt {
      compatible = "zmk,behavior-mod-morph";
      label = "RPAR_GT";
      #binding-cells = <0>;
      bindings = <&kp )>, <&kp DT_GT>;
      mods = <(MOD_LSFT|MOD_RSFT)>;
    };

    /* Tap: SPACE | Hold: NAV */
    lt_spc: lt_spc {
      compatible = "zmk,behavior-hold-tap";
      label = "LT_SPC";
      #binding-cells = <2>;
      flavor = "balanced";
      tapping-term-ms = <200>;
      quick-tap-ms = <175>;
      bindings = <&mo>, <&kp>;
    };

    /* Sticky shift + leader */
    leader_sft: leader_sft {
      compatible = "zmk,behavior-macro";
      label = "LEADER_SFT";
      #binding-cells = <0>;
      wait-ms = <0>;
      tap-ms = <5>;
      bindings = <&sk LSHFT &leader>;
    };
  };

  keymap {
    compatible = "zmk,keymap";

    default_layer {
      bindings = <
        &kp Q          &kp W          &kp E          &kp R          &kp T                &kp Y          &kp U          &kp I          &kp O          &kp P
        &hml LGUI A    &hml LALT S    &hml LCTRL D   &hml LSHFT F   &kp G                &kp H          &hmr RSHFT J    &hmr RCTRL K    &hmr RALT L     &hmr RGUI DT_SEMI
        &kp Z          &kp X          &kp C          &kp V          &kp B                &kp N          &kp M          &kp ,    &kp .      &kp /
                                     &lt FN TAB      &lt NAV BSPC   &magic_shift LSHFT 0         &kp SPACE        &smart_num NUM 0  &kp RET
      >;
    };

    nav_layer {
      bindings = <
        &kp LA(F4)     ___            &kp LS(TAB)    &swapper        ___                 &kp HOME        &kp PG_DN       &kp PG_UP      &kp END         &kp INS
        &kp LG(N5)     &kp LG(N4)     &kp LG(N3)     &kp LG(N2)      &kp LG(N1)          &kp LEFT        &kp DOWN        &kp UP         &kp RIGHT       &kp '
        &sk LGUI       &sk LALT       &sk LCTRL      &sk LSHFT       ___                 &kp DT_BSLH     &kp |     &kp ~   &kp $     &kp %
                                     ___            ___             &kp K_CANCEL        ___            ___            ___
      >;
    };

    fn_layer {
      bindings = <
        &kp F1         &kp F2         &kp F3         &kp F4          &kp F5              &kp F6         &kp F7         &kp F8         &kp F9         &kp F10
        ___            ___            ___            ___             ___                 &kp F11        &kp F12        &kp LC(LA(DEL)) ___            ___
        &out OUT_USB   &out OUT_BLE   &bt BT_SEL 0   &bt BT_SEL 1    &bt BT_SEL 2        &bt BT_SEL 3   &bt BT_CLR     ___            ___            ___
                                     ___            ___             ___                 ___            ___            ___
      >;
    };

    num_layer {
      bindings = <
        ___            &kp N7         &kp N8         &kp N9          ___                 &kp !    &kp @      &kp #    &kp $    &kp %
        ___            &kp N4         &kp N5         &kp N6          ___                 &kp ?   &kp DT_AMPS    &kp *    &kp (    &kp )
        &kp N0         &kp N1         &kp N2         &kp N3          &kp N0              &kp -   &kp +    &kp =   &kp DT_UNDER   &kp ^
                                     ___            ___             ___                 ___            ___            ___
      >;
    };

    sys_layer {
      bindings = <
        &bt BT_SEL 0   &bt BT_SEL 1   &bt BT_SEL 2   &bt BT_SEL 3    &bt BT_CLR          ___            ___            ___            ___            ___
        ___            ___            ___            ___             &bootloader         &bootloader    ___            ___            ___            ___
        ___            ___            ___            ___             &sys_reset          &sys_reset     ___            ___            ___            ___
                                     ___            ___             ___                 ___            ___            ___
      >;
    };

    mouse_layer {
      bindings = <
        ___            ___            ___            ___             ___                 ___            &kp PG_UP      U_MS_U         &kp PG_DN      ___
        ___            ___            ___            ___             ___                 U_WH_L         U_MS_L         U_MS_D         U_MS_R         U_WH_R
        ___            ___            ___            ___             ___                 ___            &mkp LCLK      &mkp MCLK      &mkp RCLK      ___
                                     ___            ___             ___                 ___            U_WH_U         U_WH_D
      >;
    };
  };
};

/* Combos must come after layer constants + behaviors are defined */
/* --- inlined: combos.dtsi --- */
/*
 * urob-style symbol/navigation combos, adapted for Swedish keycodes (keys_sv.h).
 *
 * Key positions come from: <zmk-helpers/key-labels/36.h>
 *
 * Layout legend (positions):
 * ┌─────────────────────┐ ┌─────────────────────┐
 * │ LT4 LT3 LT2 LT1 LT0 │ │ RT0 RT1 RT2 RT3 RT4 │
 * │ LM4 LM3 LM2 LM1 LM0 │ │ RM0 RM1 RM2 RM3 RM4 │
 * │ LB4 LB3 LB2 LB1 LB0 │ │ RB0 RB1 RB2 RB3 RB4 │
 * └───────┐ LH2 LH1 LH0 │ │ RH0 RH1 RH2 ┌───────┘
 *         └─────────────┘ └─────────────┘
 */

#define COMBO_TERM_FAST 25
#define COMBO_TERM_SLOW 70

#define COMBO_IDLE_FAST 150
/* Lower idle requirement makes roll-style combos easier */
#define COMBO_IDLE_SLOW 0

/ {
  combos {
    compatible = "zmk,combos";

    /* Horizontal combos - left hand */
    combo_esc {
      timeout-ms = <COMBO_TERM_FAST>;
      require-prior-idle-ms = <COMBO_IDLE_FAST>;
      key-positions = <1 2>;
      bindings = <&kp ESC>;
      layers = <DEF NUM>;
    };

    combo_mouse {
      timeout-ms = <COMBO_TERM_FAST>;
      require-prior-idle-ms = <COMBO_IDLE_FAST>;
      key-positions = <2 3>;
      bindings = <&smart_mouse>;
      layers = <DEF NUM>;
    };

    combo_tab {
      timeout-ms = <COMBO_TERM_FAST>;
      require-prior-idle-ms = <COMBO_IDLE_FAST>;
      key-positions = <11 12>;
      bindings = <&kp TAB>;
      layers = <DEF NUM>;
    };

    combo_leader {
      timeout-ms = <COMBO_TERM_FAST>;
      require-prior-idle-ms = <COMBO_IDLE_FAST>;
      key-positions = <12 13>;
      bindings = <&leader>;
      layers = <DEF NUM>;
    };

    combo_leader_shift {
      timeout-ms = <COMBO_TERM_FAST>;
      require-prior-idle-ms = <COMBO_IDLE_FAST>;
      key-positions = <11 12 13>;
      bindings = <&leader_sft>;
      layers = <DEF NUM>;
    };

    combo_cut {
      timeout-ms = <COMBO_TERM_FAST>;
      require-prior-idle-ms = <COMBO_IDLE_FAST>;
      key-positions = <21 23>;
      bindings = <&kp LC(X)>;
      layers = <DEF NUM>;
    };

    combo_copy {
      timeout-ms = <COMBO_TERM_FAST>;
      require-prior-idle-ms = <COMBO_IDLE_FAST>;
      key-positions = <21 22>;
      bindings = <&kp LC(C)>;
      layers = <DEF NUM>;
    };

    combo_paste {
      timeout-ms = <COMBO_TERM_FAST>;
      require-prior-idle-ms = <COMBO_IDLE_FAST>;
      key-positions = <22 23>;
      bindings = <&kp LC(V)>;
      layers = <DEF NUM>;
    };

    /* Horizontal combos - right hand */
    combo_bspc {
      timeout-ms = <COMBO_TERM_FAST>;
      require-prior-idle-ms = <COMBO_IDLE_FAST>;
      key-positions = <6 7>;
      bindings = <&kp BSPC>;
      layers = <DEF NUM>;
    };

    combo_del {
      timeout-ms = <COMBO_TERM_FAST>;
      require-prior-idle-ms = <COMBO_IDLE_FAST>;
      key-positions = <7 8>;
      bindings = <&kp DEL>;
      layers = <DEF NUM>;
    };

    combo_lpar {
      timeout-ms = <COMBO_TERM_FAST>;
      require-prior-idle-ms = <COMBO_IDLE_FAST>;
      key-positions = <16 17>;
      bindings = <&lpar_lt>;
      layers = <DEF NUM>;
    };

    combo_rpar {
      timeout-ms = <COMBO_TERM_FAST>;
      require-prior-idle-ms = <COMBO_IDLE_FAST>;
      key-positions = <17 18>;
      bindings = <&rpar_gt>;
      layers = <DEF NUM>;
    };

    combo_lbkt {
      timeout-ms = <COMBO_TERM_FAST>;
      require-prior-idle-ms = <COMBO_IDLE_FAST>;
      key-positions = <26 27>;
      bindings = <&kp [>;
      layers = <DEF NUM>;
    };

    combo_rbkt {
      timeout-ms = <COMBO_TERM_FAST>;
      require-prior-idle-ms = <COMBO_IDLE_FAST>;
      key-positions = <27 28>;
      bindings = <&kp ]>;
      layers = <DEF NUM>;
    };

    combo_lbrc {
      timeout-ms = <COMBO_TERM_FAST>;
      require-prior-idle-ms = <COMBO_IDLE_FAST>;
      key-positions = <26 27>;
      bindings = <&kp DT_LBRC>;
      layers = <NAV>;
    };

    combo_rbrc {
      timeout-ms = <COMBO_TERM_FAST>;
      require-prior-idle-ms = <COMBO_IDLE_FAST>;
      key-positions = <27 28>;
      bindings = <&kp DT_RBRC>;
      layers = <NAV>;
    };

    /* SYS layer access - NAV layer only */
    combo_sys {
      timeout-ms = <COMBO_TERM_FAST>;
      require-prior-idle-ms = <COMBO_IDLE_FAST>;
      key-positions = <2 4>;
      bindings = <&sl SYS>;
      layers = <NAV>;
    };

    /* Swedish vowels - right hand, NUM layer only */
    combo_a_ring {
      timeout-ms = <COMBO_TERM_FAST>;
      require-prior-idle-ms = <COMBO_IDLE_FAST>;
      key-positions = <8 9>;
      bindings = <&kp å>;
      layers = <NUM>;
    };

    combo_o_umlaut {
      timeout-ms = <COMBO_TERM_FAST>;
      require-prior-idle-ms = <COMBO_IDLE_FAST>;
      key-positions = <18 19>;
      bindings = <&kp ö>;
      layers = <NUM>;
    };

    combo_a_umlaut {
      timeout-ms = <COMBO_TERM_FAST>;
      require-prior-idle-ms = <COMBO_IDLE_FAST>;
      key-positions = <28 29>;
      bindings = <&kp ä>;
      layers = <NUM>;
    };

    /* Vertical combos - left hand */
    combo_at {
      timeout-ms = <COMBO_TERM_SLOW>;
      require-prior-idle-ms = <COMBO_IDLE_SLOW>;
      key-positions = <1 11>;
      bindings = <&kp @>;
      layers = <DEF NUM>;
    };

    combo_hash {
      timeout-ms = <COMBO_TERM_SLOW>;
      require-prior-idle-ms = <COMBO_IDLE_SLOW>;
      key-positions = <2 12>;
      bindings = <&kp #>;
      layers = <DEF NUM>;
    };

    combo_dllr {
      timeout-ms = <COMBO_TERM_SLOW>;
      require-prior-idle-ms = <COMBO_IDLE_SLOW>;
      key-positions = <3 13>;
      bindings = <&kp $>;
      layers = <DEF NUM>;
    };

    combo_prcnt {
      timeout-ms = <COMBO_TERM_SLOW>;
      require-prior-idle-ms = <COMBO_IDLE_SLOW>;
      key-positions = <4 14>;
      bindings = <&kp %>;
      layers = <DEF NUM>;
    };

    combo_grave {
      timeout-ms = <COMBO_TERM_SLOW>;
      require-prior-idle-ms = <COMBO_IDLE_SLOW>;
      key-positions = <11 21>;
      bindings = <&kp `>;
      layers = <DEF NUM>;
    };

    combo_bslh {
      timeout-ms = <COMBO_TERM_SLOW>;
      require-prior-idle-ms = <COMBO_IDLE_SLOW>;
      key-positions = <12 22>;
      bindings = <&kp DT_BSLH>;
      layers = <DEF NUM>;
    };

    combo_equal {
      timeout-ms = <COMBO_TERM_SLOW>;
      require-prior-idle-ms = <COMBO_IDLE_SLOW>;
      key-positions = <13 23>;
      bindings = <&kp =>;
      layers = <DEF NUM>;
    };

    combo_tilde {
      timeout-ms = <COMBO_TERM_SLOW>;
      require-prior-idle-ms = <COMBO_IDLE_SLOW>;
      key-positions = <14 24>;
      bindings = <&kp ~>;
      layers = <DEF NUM>;
    };

    /* Vertical combos - right hand */
    combo_caret {
      timeout-ms = <COMBO_TERM_SLOW>;
      require-prior-idle-ms = <COMBO_IDLE_SLOW>;
      key-positions = <5 15>;
      bindings = <&kp ^>;
      layers = <DEF NUM>;
    };

    combo_plus {
      timeout-ms = <COMBO_TERM_SLOW>;
      require-prior-idle-ms = <COMBO_IDLE_SLOW>;
      key-positions = <6 16>;
      bindings = <&kp +>;
      layers = <DEF NUM>;
    };

    combo_star {
      timeout-ms = <COMBO_TERM_SLOW>;
      require-prior-idle-ms = <COMBO_IDLE_SLOW>;
      key-positions = <7 17>;
      bindings = <&kp *>;
      layers = <DEF NUM>;
    };

    combo_amps {
      timeout-ms = <COMBO_TERM_SLOW>;
      require-prior-idle-ms = <COMBO_IDLE_SLOW>;
      key-positions = <8 18>;
      bindings = <&kp DT_AMPS>;
      layers = <DEF NUM>;
    };

    combo_under {
      timeout-ms = <COMBO_TERM_SLOW>;
      require-prior-idle-ms = <COMBO_IDLE_SLOW>;
      key-positions = <15 25>;
      bindings = <&kp DT_UNDER>;
      layers = <DEF NUM>;
    };

    combo_minus {
      timeout-ms = <COMBO_TERM_SLOW>;
      require-prior-idle-ms = <COMBO_IDLE_SLOW>;
      key-positions = <16 26>;
      bindings = <&kp ->;
      layers = <DEF NUM>;
    };

    combo_fslh {
      timeout-ms = <COMBO_TERM_SLOW>;
      require-prior-idle-ms = <COMBO_IDLE_SLOW>;
      key-positions = <17 27>;
      bindings = <&kp />;
      layers = <DEF NUM>;
    };

    combo_pipe {
      timeout-ms = <COMBO_TERM_SLOW>;
      require-prior-idle-ms = <COMBO_IDLE_SLOW>;
      key-positions = <18 28>;
      bindings = <&kp |>;
      layers = <DEF NUM>;
    };
  };
};

